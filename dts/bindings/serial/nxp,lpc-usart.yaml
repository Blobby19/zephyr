## dts/bindings/serial/nxp,lpc-usart.yaml
```yaml
# Copyright (c) 2017, NXP
# SPDX-License-Identifier: Apache-2.0

description: LPC USART

compatible: "nxp,lpc-usart"

properties:
  parity:
    required: false
    type: int
    description: |
      Configures the parity of the adapter. Value 0 for none, 1 for odd
      and 2 for even parity.  Default to none if not specified.

include: [uart-controller.yaml, "nxp,lpc-flexcomm.yaml"]
```
